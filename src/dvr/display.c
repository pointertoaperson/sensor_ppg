#include "sensor_ppg.h"
#include "process_sequence.h"
#include "display.h"
char *text;
const uint8_t font[][6] = {
    {0x00, 0x00, 0x00, 0x00, 0x00, 0x00}, // sp
    {0x00, 0x00, 0x00, 0x2f, 0x00, 0x00}, // !
    {0x00, 0x00, 0x07, 0x00, 0x07, 0x00}, // "
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    {0x00, 0x08, 0x04, 0x08, 0x08, 0x04}, // ~
    /* end of normal char-set */
    /* put your own signs/chars here, edit special_char too */
    /* be sure that your first special char stand here */
    {0x00, 0x3A, 0x40, 0x40, 0x20, 0x7A}, // ü, !!! Important: this must be special_char[0] !!!
    {0x00, 0x3D, 0x40, 0x40, 0x40, 0x3D}, // Ü
    {0x00, 0x21, 0x54, 0x54, 0x54, 0x79}, // ä
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    {0x00, 0x5C, 0x62, 0x02, 0x62, 0x5C} // Ω
    
// Add more characters for the rest of the printable ASCII characters...
};
void draw_text(char* text, uint8_t x, uint8_t y) {
    y = 24;  // Start from bottom row (32 - 8 = 24)
    for (int i = 0; text[i] != '\0'; i++) {
        if (x >= 128) {
            x = 0;
            y += 8;  // Move upward
            if (y < 16) break;  // Limit to bottom half
        }

        uint8_t character = text[i] - 32;
        if (character < 95) {
            for (uint8_t row = 0; row < 6; row++) {
                uint8_t pixel_data = font[character][row];
                uint8_t flipped_pixel_data = 0;  // This will store the flipped row

                // Flip the bits horizontally
                for (uint8_t col = 0; col < 8; col++) {
                    if (pixel_data & (1 << col)) {
                        flipped_pixel_data |= (1 << (7 - col));  // Set the corresponding bit in the flipped data
                    }
                }

                // Now draw the flipped pixels
                for (uint8_t col = 0; col < 8; col++) {
                    if (flipped_pixel_data & (1 << col)) {
                        draw_pixel_text(x + row, y + col);
                    }
                }
            }
        }
        x += 8;  // Move the cursor by the width of the character
    }
}


void draw_pixel_text(uint8_t x, uint8_t y) {
    if (x >= 128 || y < 24 || y >= 32) return;  // Limit to bottom half
    buffer[x + (y / 8) * 128] |= (1 << (y % 8));
}


// --- SSD1306 Functions ---
void ssd1306_sendCommand(uint8_t cmd) {
    i2c_start(SSD1306_ADDRESS);
    i2c_write(0x00); // Command mode
    i2c_write(cmd);  // Send command
    i2c_stop();
}

void ssd1306_init(void) {
    _delay_ms(100);
    ssd1306_sendCommand(0xAE); // Display off
    ssd1306_sendCommand(0x20); // Set Memory Addressing Mode
    ssd1306_sendCommand(0x00); // Horizontal Addressing Mode
    ssd1306_sendCommand(0xB0); // Set Page Start Address
    ssd1306_sendCommand(0xC0); // COM Output Scan Direction (upwards)
    ssd1306_sendCommand(0x00); // Low Column Start Address
    ssd1306_sendCommand(0x10); // High Column Start Address
    ssd1306_sendCommand(0x40); // Start Line Address
    ssd1306_sendCommand(0x81); // Contrast Control
    ssd1306_sendCommand(0x7F);
    ssd1306_sendCommand(0xA1); // Segment Re-map
    ssd1306_sendCommand(0xA6); // Normal Display
    ssd1306_sendCommand(0xA8); // Multiplex Ratio
    ssd1306_sendCommand(0x1F); // 32 rows, so 1F (31 decimal) is appropriate
    ssd1306_sendCommand(0xA4); // Output RAM to Display
    ssd1306_sendCommand(0xD3); // Display Offset
    ssd1306_sendCommand(0x00);
    ssd1306_sendCommand(0xD5); // Display Clock Divide Ratio
    ssd1306_sendCommand(0xF0);
    ssd1306_sendCommand(0xD9); // Pre-charge Period
    ssd1306_sendCommand(0x22);
    ssd1306_sendCommand(0xDA); // COM Pins
    ssd1306_sendCommand(0x02);
    ssd1306_sendCommand(0xDB); // VCOMH Deselect Level
    ssd1306_sendCommand(0x20);
    ssd1306_sendCommand(0x8D); // Charge Pump Setting
    ssd1306_sendCommand(0x14);
    ssd1306_sendCommand(0xAF); // Display ON
}
void ssd1306_set_address_range(uint8_t start_page, uint8_t end_page) {
    ssd1306_sendCommand(0x21); // Set column address
    ssd1306_sendCommand(0);    // Start column
    ssd1306_sendCommand(127);  // End column
    ssd1306_sendCommand(0x22); // Set page address
    ssd1306_sendCommand(start_page);
    ssd1306_sendCommand(end_page);
}
void ssd1306_updateDisplay_text(void) {
    // Write entire display buffer at once
    i2c_start(SSD1306_ADDRESS);
    i2c_write(0x40); // Data mode
  
    // Write 128x32 pixels in the buffer (512 bytes in total)
    for (uint16_t i = 384; i < BUFFER_SIZE; i++) {
        i2c_write(buffer[i]);
    }
    
    i2c_stop();
}


void ssd1306_updateDisplay_wave(void) {
    // Write entire display buffer at once
    i2c_start(SSD1306_ADDRESS);
    i2c_write(0x40); // Data mode
    
    // Write 128x32 pixels in the buffer (512 bytes in total)
    for (uint16_t i = 0; i < 384; i++) {
        i2c_write(buffer[i]);
    }
    
    i2c_stop();
}
void ssd1306_clearDisplay_banner(void) {
    // memset(buffer, 0x00, sizeof(buffer)); // Clear the buffer by setting all to 0
    memset(&buffer[384], 0, (128) * sizeof(buffer[0]));
 }
 
void ssd1306_clearDisplay(void) {
   // memset(buffer, 0x00, sizeof(buffer)); // Clear the buffer by setting all to 0
   memset(&buffer[0], 0, (384) * sizeof(buffer[0]));
}

// --- Function to Draw a Pixel ---
void draw_pixel(uint8_t x, uint8_t y) {
    if (x >= 128 || y >= 24) return;  // Ensure within bounds
    
    buffer[x + (y / 8) * 128] |= (1 << (y % 8));
}


void draw_waveform(uint16_t* psample, int16_t data_len)
{
    uint16_t len = 0;
    while ( len < data_len )
    {
        uint8_t screen_pos = (len & 0x7F);
        uint16_t y = (*psample / 45);

        if (screen_pos == 0)
            ssd1306_clearDisplay();
        draw_pixel(screen_pos, y);
        len++;
        psample++;
    }
    
}
   
