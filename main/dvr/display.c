#include "display.h"

#define TAG "SSD1306"
static esp_err_t ssd1306_write_cmd(uint8_t cmd); 
static esp_err_t ssd1306_write_data(uint8_t* data, size_t len);

static uint8_t ssd1306_buffer[BUFFER_SIZE];

const uint8_t font[][6] = {
    {0x00, 0x00, 0x00, 0x00, 0x00, 0x00}, // sp
    {0x00, 0x00, 0x00, 0x2f, 0x00, 0x00}, // !
    {0x00, 0x00, 0x07, 0x00, 0x07, 0x00}, // "
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    {0x00, 0x08, 0x04, 0x08, 0x08, 0x04}, // ~
    /* end of normal char-set */
    /* put your own signs/chars here, edit special_char too */
    /* be sure that your first special char stand here */
    {0x00, 0x3A, 0x40, 0x40, 0x20, 0x7A}, // ü, !!! Important: this must be special_char[0] !!!
    {0x00, 0x3D, 0x40, 0x40, 0x40, 0x3D}, // Ü
    {0x00, 0x21, 0x54, 0x54, 0x54, 0x79}, // ä
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    {0x00, 0x5C, 0x62, 0x02, 0x62, 0x5C}  // Ω

    // Add more characters for the rest of the printable ASCII characters...
};

// I2C helper function to write command or data to SSD1306
static esp_err_t ssd1306_write_cmd(uint8_t cmd)
{
    i2c_cmd_handle_t handle = i2c_cmd_link_create();
    esp_err_t ret;

    i2c_master_start(handle);
    i2c_master_write_byte(handle, (SSD1306_ADDR << 1) | I2C_MASTER_WRITE, true);

    // Control byte 0x00 means next byte is command
    i2c_master_write_byte(handle, 0x00, true);
    i2c_master_write_byte(handle, cmd, true);

    i2c_master_stop(handle);
    ret = i2c_master_cmd_begin(I2C_MASTER_NUM, handle, 1000 / portTICK_PERIOD_MS);
    i2c_cmd_link_delete(handle);
    return ret;
}

static esp_err_t ssd1306_write_data(uint8_t *data, size_t len)
{
    i2c_cmd_handle_t handle = i2c_cmd_link_create();
    esp_err_t ret;

    i2c_master_start(handle);
    i2c_master_write_byte(handle, (SSD1306_ADDR << 1) | I2C_MASTER_WRITE, true);

    // Control byte 0x40 means next bytes are data stream
    i2c_master_write_byte(handle, 0x40, true);
    i2c_master_write(handle, data, len, true);

    i2c_master_stop(handle);
    ret = i2c_master_cmd_begin(I2C_MASTER_NUM, handle, 1000 / portTICK_PERIOD_MS);
    i2c_cmd_link_delete(handle);
    return ret;
}

// Initialize I2C peripheral
void i2c_master_init(void)
{
    i2c_config_t conf = {
        .mode = I2C_MODE_MASTER,
        .sda_io_num = I2C_MASTER_SDA_IO,
        .scl_io_num = I2C_MASTER_SCL_IO,
        .sda_pullup_en = GPIO_PULLUP_ENABLE,
        .scl_pullup_en = GPIO_PULLUP_ENABLE,
        .master.clk_speed = I2C_MASTER_FREQ_HZ,
    };
    i2c_param_config(I2C_MASTER_NUM, &conf);
    i2c_driver_install(I2C_MASTER_NUM, conf.mode, 0, 0, 0);
}

// Initialize SSD1306 OLED with basic setup commands
void ssd1306_init(void)
{
    vTaskDelay(pdMS_TO_TICKS(100)); // Wait after power on

    ssd1306_write_cmd(0xAE); // Display off
    ssd1306_write_cmd(0x20); // Set Memory Addressing Mode
    ssd1306_write_cmd(0x00); // Horizontal Addressing Mode
    ssd1306_write_cmd(0xB0); // Set Page Start Address
    ssd1306_write_cmd(0xC8); // COM Output Scan Direction (downwards)
    ssd1306_write_cmd(0x00); // Low Column Start Address
    ssd1306_write_cmd(0x10); // High Column Start Address
    ssd1306_write_cmd(0x40); // Start Line Address
    ssd1306_write_cmd(0x81); // Contrast Control
    ssd1306_write_cmd(0x7F);
    ssd1306_write_cmd(0xA1); // Segment Re-map
    ssd1306_write_cmd(0xA6); // Normal Display
    ssd1306_write_cmd(0xA8); // Multiplex Ratio
    ssd1306_write_cmd(0x1F); // 32 rows, so 1F (31 decimal) is appropriate
    ssd1306_write_cmd(0xA4); // Output RAM to Display
    ssd1306_write_cmd(0xD3); // Display Offset
    ssd1306_write_cmd(0x00);
    ssd1306_write_cmd(0xD5); // Display Clock Divide Ratio
    ssd1306_write_cmd(0xF0);
    ssd1306_write_cmd(0xD9); // Pre-charge Period
    ssd1306_write_cmd(0x22);
    ssd1306_write_cmd(0xDA); // COM Pins
    ssd1306_write_cmd(0x02);
    ssd1306_write_cmd(0xDB); // VCOMH Deselect Level
    ssd1306_write_cmd(0x20);
    ssd1306_write_cmd(0x8D); // Charge Pump Setting
    ssd1306_write_cmd(0x14);
    ssd1306_write_cmd(0xAF); // Display ON
}

// Clear internal buffer and update OLED
void ssd1306_clear(void)
{
    memset(ssd1306_buffer, 0, sizeof(ssd1306_buffer));
    // Set column and page to 0
    ssd1306_write_cmd(0x21);              // Set column address
    ssd1306_write_cmd(0);                 // Start column
    ssd1306_write_cmd(SSD1306_WIDTH - 1); // End column

    ssd1306_write_cmd(0x22);              // Set page address
    ssd1306_write_cmd(0);                 // Start page
    ssd1306_write_cmd(SSD1306_PAGES - 1); // End page

    ssd1306_write_data(ssd1306_buffer, sizeof(ssd1306_buffer));
}

// Send buffer to SSD1306 display
void ssd1306_update(void)
{
    ssd1306_write_cmd(0x21); // Set column address
    ssd1306_write_cmd(0);
    ssd1306_write_cmd(SSD1306_WIDTH - 1);

    ssd1306_write_cmd(0x22); // Set page address
    ssd1306_write_cmd(0);
    ssd1306_write_cmd(SSD1306_PAGES - 1);

    ssd1306_write_data(ssd1306_buffer, sizeof(ssd1306_buffer));
}

// Draw a pixel in the buffer
void ssd1306_draw_pixel(int x, int y, bool color)
{
    if (x < 0 || x >= SSD1306_WIDTH || y < 0 || y >= SSD1306_HEIGHT)
        return;

    int page = y / 8;
    int bit_pos = y % 8;
    if (color)
    {
        ssd1306_buffer[x + page * SSD1306_WIDTH] |= (1 << bit_pos);
    }
    else
    {
        ssd1306_buffer[x + page * SSD1306_WIDTH] &= ~(1 << bit_pos);
    }
}

// Draw a character (5x7) at pixel position (x,y) using font5x7
void ssd1306_draw_char(int x, int y, char c)
{
    if (c < 32 || c > 127)
        return; // unsupported char

    const uint8_t *bitmap = font[c - 32];
    for (int i = 0; i < 6; i++)
    { // columns
        uint8_t line = bitmap[i];
        for (int j = 0; j < 7; j++)
        { // rows
            bool pixel_on = line & (1 << j);
            ssd1306_draw_pixel(x + i, y + j, pixel_on);
        }
    }
}

// Draw a string at pixel position (x,y)
void ssd1306_draw_text(int x, int y, const char *str)
{
    while (*str)
    {
        ssd1306_draw_char(x, y, *str);
        x += 6; // 5 pixels width + 1 pixel spacing
        str++;
    }
    ssd1306_update();
}

void animate(uint16_t adc_val)
{

    uint16_t y = 32 - adc_val;
    ssd1306_buffer[(y / 8) * 128] |= (0x1 << (y % 8));
    // buffer[((y / 8) * 128)+1] |= (0x2 << (y % 8));

    for (uint8_t cntr = 0; cntr < 3; cntr++)
    {
        memmove(ssd1306_buffer + 128, ssd1306_buffer + 127, 127);
        memmove(ssd1306_buffer + 256, ssd1306_buffer + 255, 127);
        memmove(ssd1306_buffer + 384, ssd1306_buffer + 383, 127);
    }

    ssd1306_update();
}