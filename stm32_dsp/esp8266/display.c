/**
 * @file    display.c
 * @brief   SSD1306 OLED display driver implementation for ESP8266
 * @author  Umesh Puri
 * @date    2025-06-02
 * @version 1.0
 *
 * This file implements functions to control the SSD1306 OLED display
 * over I2C/SPI interface, including initialization, drawing, and updating the screen.
 *
 * @license MIT License
 * Copyright (c) 2025 Umesh
 */

#include "display.h"

char *text;
const uint8_t font[][6] = {
    {0x00, 0x00, 0x00, 0x00, 0x00, 0x00}, // sp
    {0x00, 0x00, 0x00, 0x2f, 0x00, 0x00}, // !
    {0x00, 0x00, 0x07, 0x00, 0x07, 0x00}, // "
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    {0x00, 0x08, 0x04, 0x08, 0x08, 0x04}, // ~
    /* end of normal char-set */
    /* put your own signs/chars here, edit special_char too */
    /* be sure that your first special char stand here */
    {0x00, 0x3A, 0x40, 0x40, 0x20, 0x7A}, // ü, !!! Important: this must be special_char[0] !!!
    {0x00, 0x3D, 0x40, 0x40, 0x40, 0x3D}, // Ü
    {0x00, 0x21, 0x54, 0x54, 0x54, 0x79}, // ä
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    {0x00, 0x5C, 0x62, 0x02, 0x62, 0x5C}  // Ω

    // Add more characters for the rest of the printable ASCII characters...
};
void draw_text(char *text, uint8_t x, uint8_t y)
{
    memset(buffer, 0x00, 128);
    y = 0;
    for (int i = 0; text[i] != '\0'; i++)
    {
        if (x >= 128)
        {
            x = 0;
        }

        uint8_t character = text[i] - 32;
        if (character < 95)
        {
            for (uint8_t row = 0; row < 6; row++)
            {
                uint8_t pixel_data = font[character][row];
                uint8_t flipped_pixel_data = 0;

                for (uint8_t col = 0; col < 8; col++)
                {
                    if (pixel_data & (1 << col))
                    {
                        flipped_pixel_data |= (1 << (col));
                    }
                }

                // clear banner

                for (uint8_t col = 0; col < 8; col++)
                {
                    if (flipped_pixel_data & (1 << col))
                    {
                        draw_pixel(x + row, y + col);
                    }
                }
            }
        }
        x += 8; // Move the cursor by the width of the character
    }
    // update banner
    ssd1306_updateDisplay(0);
}

/*
void draw_pixel_text(uint8_t x, uint8_t y) {
    if (x >= 128 || y < 0 || y >= 32) return;  // Limit to bottom half
    buffer[x + (y / 8) * 128] |= (1 << (y % 8));
}
*/

void ssd1306_init()
{

    i2c_cmd_handle_t cmd = i2c_cmd_link_create();

    i2c_master_start(cmd);
    i2c_master_write_byte(cmd, (OLED_I2C_ADDRESS << 1) | 0, true);
    i2c_master_write_byte(cmd, OLED_CONTROL_BYTE_CMD_STREAM, true);

    i2c_master_write_byte(cmd, 0xAE, true); // Display off
    i2c_master_write_byte(cmd, 0x20, true); // Set Memory Addressing Mode
    i2c_master_write_byte(cmd, 0x00, true); // Horizontal Addressing Mode
    i2c_master_write_byte(cmd, 0xB0, true); // Set Page Start Address
    i2c_master_write_byte(cmd, 0xC8, true); // COM Output Scan Direction (downwards)
    i2c_master_write_byte(cmd, 0x00, true); // Low Column Start Address
    i2c_master_write_byte(cmd, 0x10, true); // High Column Start Address
    i2c_master_write_byte(cmd, 0x40, true); // Start Line Address
    i2c_master_write_byte(cmd, 0x81, true); // Contrast Control
    i2c_master_write_byte(cmd, 0x7F, true);
    i2c_master_write_byte(cmd, 0xA1, true); // Segment Re-map
    i2c_master_write_byte(cmd, 0xA6, true); // Normal Display
    i2c_master_write_byte(cmd, 0xA8, true); // Multiplex Ratio
    i2c_master_write_byte(cmd, 0x1F, true); // 32 rows, so 1F (31 decimal) is appropriate
    i2c_master_write_byte(cmd, 0xA4, true); // Output RAM to Display
    i2c_master_write_byte(cmd, 0xD3, true); // Display Offset
    i2c_master_write_byte(cmd, 0x00, true);
    i2c_master_write_byte(cmd, 0xD5, true); // Display Clock Divide Ratio
    i2c_master_write_byte(cmd, 0xF0, true);
    i2c_master_write_byte(cmd, 0xD9, true); // Pre-charge Period
    i2c_master_write_byte(cmd, 0x22, true);
    i2c_master_write_byte(cmd, 0xDA, true); // COM Pins
    i2c_master_write_byte(cmd, 0x02, true);
    i2c_master_write_byte(cmd, 0xDB, true); // VCOMH Deselect Level
    i2c_master_write_byte(cmd, 0x20, true);
    i2c_master_write_byte(cmd, 0x8D, true); // Charge Pump Setting
    i2c_master_write_byte(cmd, 0x14, true);
    i2c_master_write_byte(cmd, 0xAF, true); // Display ON
    i2c_master_write_byte(cmd, OLED_CMD_DISPLAY_ON, true);

    i2c_master_stop(cmd);

    i2c_master_cmd_begin(I2C_NUM_0, cmd, 10 / portTICK_PERIOD_MS);

    i2c_cmd_link_delete(cmd);
}

void ssd1306_set_address_range(uint8_t start_page, uint8_t end_page)
{
    ssd1306_sendCommand(0x21); // Set column address
    ssd1306_sendCommand(0);    // Start column
    ssd1306_sendCommand(127);  // End column
    ssd1306_sendCommand(0x22); // Set page address
    ssd1306_sendCommand(start_page);
    ssd1306_sendCommand(end_page);
}

uint16_t start = 0;
uint16_t stop = 0;
void ssd1306_updateDisplay(uint8_t page)
{
    i2c_cmd_handle_t cmd;

    cmd = i2c_cmd_link_create();
    i2c_master_start(cmd);
    i2c_master_write_byte(cmd, (OLED_I2C_ADDRESS << 1) | 0, true);
    i2c_master_write_byte(cmd, 0x80, true);
    i2c_master_write_byte(cmd, 0xB0, true);
    i2c_master_write_byte(cmd, 0x40, true);

    for (uint16_t i = 0; i < BUFFER_SIZE; i++)
    {
        i2c_master_write_byte(cmd, buffer[i], true);
    }

    i2c_master_stop(cmd);
    i2c_master_cmd_begin(I2C_NUM_0, cmd, 10 / portTICK_PERIOD_MS);
    i2c_cmd_link_delete(cmd);

    // Write 128x32 pixels in the buffer (512 bytes in total)
}

void ssd1306_clearDisplay(void)
{
    memset(buffer, 0x00, sizeof(buffer)); // Clear the buffer by setting all to 0
                                          // memset(&buffer[0], 0, (384) * sizeof(buffer[0]));
}

// --- Function to Draw a Pixel ---
void draw_pixel(uint8_t x, uint8_t y)
{
    if (x >= 128 || y >= 32)
        return; // Ensure within bounds
    // y = 31-y ;
    buffer[x + (y / 8) * 128] |= (1 << (y % 8));
}

void draw_waveform(uint16_t *psample, uint16_t data_len)
{
    uint16_t len = 0;
    while (len < data_len)
    {
        uint8_t screen_pos = (len & 0x7F);
        uint16_t y = (*psample);
        y = 31 - y;
        draw_pixel(screen_pos, y + 8);
        len++;
        psample++;
    }
}

void animate(uint16_t adc_val)
{
    // uint16_t len = 0;
    // while(len < data_len){

    // uint16_t screen_pos =   (len & 0x7F);
    uint16_t y = 31 - adc_val;
    buffer[(y / 8) * 128] |= (1 << (y % 8));
    memmove(buffer + 128, buffer + 127, 127);

    memmove(buffer + 256, buffer + 255, 127);

    memmove(buffer + 384, buffer + 383, 127);
    ssd1306_updateDisplay(0);
    //  memset(buffer + 256,0x00,256);

    // vTaskDelay(10/portTICK_PERIOD_MS);
    //  len++;
    // psample++;

    //}
}
